## boards/ellierf/minihf/board.yml
```yaml
board:
  name: minihf
  full_name: EllieRF MiniHF
  vendor: ellierf
  socs:
    - name: stm32l431xx
```

## boards/ellierf/minihf/minihf.defconfig
```kconfig
# Enable MPU
CONFIG_ARM_MPU=y

# Enable HW stack protection
CONFIG_HW_STACK_PROTECTION=y

# enable uart driver
CONFIG_SERIAL=y

# enable i2c driver
CONFIG_I2C=y

# enable spi driver
CONFIG_SPI=y

# enable gpio driver
CONFIG_GPIO=y

# console
CONFIG_CONSOLE=y
CONFIG_UART_CONSOLE=y
```

## drivers/clock_control/Kconfig.si5351a
```kconfig
config CLOCK_CONTROL_SI5351A
    bool "Silicon Labs SI5351a clock generator"
    default y
    depends on DT_HAS_SILABS_SI5351A_ENABLED
    depends on I2C
    help
      Driver for SI5351A programmable clock generator
```

## drivers/regulator/Kconfig.tps55289
```kconfig
config REGULATOR_TPS55289
    bool "TI TPS55289 Regulator Driver"
    default y
    depends on DT_HAS_TI_TPS55289_ENABLED
    select I2C
    help
      Enable support for TI TPS55289 I2C buck-boost converter.

config REGULATOR_TPS55289_INIT_PRIORITY
    int "TPS55289 regulator driver init priority"
    default 75
    depends on REGULATOR_TPS55289
    help
      Init priority for the TPS55289 regulator driver.
```
